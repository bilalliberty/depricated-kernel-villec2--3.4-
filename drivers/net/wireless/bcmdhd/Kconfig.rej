## drivers/net/wireless/bcmdhd/Kconfig.rej
```kconfig
--- drivers/net/wireless/bcmdhd/Kconfig
+++ drivers/net/wireless/bcmdhd/Kconfig
@@ -1,8 +1,6 @@
 config BCMDHD
 	tristate "Broadcom 4329/30 wireless cards support"
 	depends on MMC
-        select WIRELESS_EXT
-        select WEXT_PRIV
 	---help---
 	  This module adds support for wireless adapters based on
 	  Broadcom 4329/30 chipset.
```
